## firmware/main/Kconfig.projbuild
```kconfig
menu "dzPanel diagnostics"

    config RU_HEAP_LOG
        bool "Periodic heap and task-stack log line, and failed-allocation log"
        default n
        help
            Logs one compact line every RU_HEAP_LOG_PERIOD_S seconds with internal and PSRAM free / largest block /
            approximate minimum-free (sum of per-heap minima) and the minimum free stack bytes of the main tasks, and logs every failed heap
            allocation (size and caps, rate limited). Numbers only, no configuration or credentials are printed.

    config RU_HEAP_LOG_PERIOD_S
        int "Heap log period (seconds)"
        depends on RU_HEAP_LOG
        range 1 3600
        default 5

endmenu
```
